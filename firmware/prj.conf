## CMakeLists.txt
```
cmake_minimum_required(VERSION 3.20.0)

find_package(Zephyr REQUIRED HINTS $ENV{ZEPHYR_BASE})
project(dhl_courier)

include(FetchContent)
FetchContent_Declare(
    cjson
    GIT_REPOSITORY https://github.com/DaveGamble/cJSON.git
    GIT_TAG        v1.7.18
    SOURCE_DIR     ${CMAKE_CURRENT_SOURCE_DIR}/external/cjson
    UPDATE_COMMAND ""
)
FetchContent_GetProperties(cjson)
if(NOT cjson_POPULATED)
    FetchContent_Populate(cjson)
endif()

target_sources(app PRIVATE
	src/gps_telemetry.c
	src/main.c
	src/provisioning.c
	src/route_manager.c
	external/cjson/cJSON.c
)

if(CONFIG_DHL_UI_QT)
    # Qt5/6 cannot be compiled under Zephyr's toolchain flags (-nostdinc,
    # -m32, no C++ stdlib).  Instead we compile ui_qt.cpp with the host
    # system compiler as a standalone object and link it into the app.
    find_program(HOST_CXX NAMES g++ c++ REQUIRED)

    # Obtain Qt5 flags via pkg-config (works regardless of Zephyr's toolchain).
    find_program(PKG_CONFIG NAMES pkg-config REQUIRED)
    execute_process(
        COMMAND ${PKG_CONFIG} --cflags Qt5Widgets
        OUTPUT_VARIABLE _qt_cflags OUTPUT_STRIP_TRAILING_WHITESPACE)
    execute_process(
        COMMAND ${PKG_CONFIG} --libs Qt5Widgets
        OUTPUT_VARIABLE _qt_libs OUTPUT_STRIP_TRAILING_WHITESPACE)

    if(_qt_cflags)
        # Convert space-separated strings into proper CMake lists.
        separate_arguments(_qt_cflags_list UNIX_COMMAND "${_qt_cflags}")
        separate_arguments(_qt_libs_list  UNIX_COMMAND "${_qt_libs}")

        set(_qt_obj "${CMAKE_CURRENT_BINARY_DIR}/ui_qt.o")
        add_custom_command(
            OUTPUT ${_qt_obj}
            COMMAND ${HOST_CXX} -c -std=c++17 -fPIC -O2
                    -I${CMAKE_CURRENT_SOURCE_DIR}/src/ui
                    ${_qt_cflags_list}
                    -o ${_qt_obj}
                    ${CMAKE_CURRENT_SOURCE_DIR}/src/ui/ui_qt.cpp
            DEPENDS ${CMAKE_CURRENT_SOURCE_DIR}/src/ui/ui_qt.cpp
                    ${CMAKE_CURRENT_SOURCE_DIR}/src/ui/ui_bridge.h
            COMMENT "Compiling ui_qt.cpp with host C++ compiler"
        )
        add_custom_target(qt_ui_object DEPENDS ${_qt_obj})
        add_dependencies(app qt_ui_object)

        target_link_libraries(app PRIVATE ${_qt_obj})

        # Qt shared libs must go into the FINAL native_sim link step (the
        # "runner"), not the intermediate relocatable link (-r).
        # INTERFACE_LINK_OPTIONS → NSI_LINK_OPTIONS → FINALLINK_FLAGS
        # (appears AFTER --no-whole-archive in the NSI Makefile).
        set_property(TARGET native_simulator APPEND PROPERTY
            INTERFACE_LINK_OPTIONS
            -L/lib/x86_64-linux-gnu ${_qt_libs_list} -lstdc++)
    else()
        message(WARNING "CONFIG_DHL_UI_QT is enabled but pkg-config Qt5Widgets not found; building stub UI.")
        target_sources(app PRIVATE src/ui/ui_stub.c)
    endif()
else()
    target_sources(app PRIVATE src/ui/ui_stub.c)
endif()

target_include_directories(app PRIVATE
    external/cjson
    src/ui
)
```

## Kconfig
```
mainmenu "DHL Courier Firmware"

menu "DHL Courier Settings"

config DHL_EMPLOYEE_ID
	string "Courier employee identifier (compile-time fallback)"
	default "courier-001"
	help
	  Compile-time default. At runtime this is overridden by the value
	  entered in the captive-portal provisioning page and stored in NVS.

config DHL_MQTT_CLIENT_ID
	string "MQTT client identifier"
	default "dhl_courier_001"
	help
	  MQTT client identifier presented to the broker at connect time.

config DHL_MQTT_BROKER_HOSTNAME
	string "MQTT broker hostname or IPv4 address"
	default "localhost"
	help
	  Hostname or IP address of the MQTT broker.

config DHL_MQTT_BROKER_PORT
	int "MQTT broker port"
	range 1 65535
	default 1883

config DHL_MQTT_KEEPALIVE
	int "MQTT keepalive in seconds"
	range 10 1200
	default 60

config DHL_MQTT_RECONNECT_DELAY
	int "MQTT reconnect delay in seconds"
	range 1 300
	default 5

config DHL_UI_QT
	bool "Enable Qt desktop UI for local simulation"
	depends on BOARD_NATIVE_POSIX || BOARD_NATIVE_POSIX_64 || BOARD_NATIVE_SIM
	default y
	help
	  Build the desktop UI implementation used for local simulation on the
	  host machine. Real boards keep using the UI bridge API but compile the
	  stub implementation until an LVGL backend is added.

if WIFI

config DHL_WIFI_SSID
	string "Wi-Fi SSID (compile-time fallback)"
	default ""
	help
	  Compile-time default only. At runtime the SSID is entered via the
	  captive-portal and stored in NVS flash. Leave empty to always use
	  the captive portal on first boot.

config DHL_WIFI_PSK
	string "Wi-Fi passphrase (compile-time fallback)"
	default ""
	help
	  Compile-time default only. See DHL_WIFI_SSID.

endif

menu "Route Manager"

config DHL_ROUTE_MAX_STOPS
	int "Maximum number of stops in a delivery route"
	range 1 64
	default 16
	help
	  Upper bound on the number of stops the device can hold in memory
	  for a single route.  Each stop occupies DHL_ROUTE_STOP_NAME_MAX
	  bytes of static RAM, so raising this value increases the
	  route_state footprint linearly.  16 covers the typical last-mile
	  delivery run with comfortable margin.

config DHL_ROUTE_STOP_NAME_MAX
	int "Maximum length of a stop name (bytes, including null terminator)"
	range 8 256
	default 64
	help
	  Maximum number of bytes (including the trailing null) for a single
	  stop name received from the backend.  Names longer than this are
	  silently truncated.  64 bytes is enough for a full street-level
	  address in Spanish/English.

endmenu

endmenu

source "Kconfig.zephyr"
```

## prj.conf
```kconfig
# ── Networking ──────────────────────────────────────────────────────────────
CONFIG_NETWORKING=y
CONFIG_NET_IPV4=y
CONFIG_NET_IPV6=n
CONFIG_NET_TCP=y
CONFIG_NET_UDP=y
CONFIG_NET_SOCKETS=y
CONFIG_DNS_RESOLVER=y
CONFIG_SNTP=y
CONFIG_MQTT_LIB=y
CONFIG_NET_CONNECTION_MANAGER=y

# ── Console / log ────────────────────────────────────────────────────────────
CONFIG_POSIX_API=y
CONFIG_PRINTK=y
CONFIG_STDOUT_CONSOLE=y
CONFIG_LOG=y
CONFIG_LOG_DEFAULT_LEVEL=3

CONFIG_NET_HOSTNAME_ENABLE=y
CONFIG_NET_HOSTNAME="dhl-courier"

# ── Stack / heap ─────────────────────────────────────────────────────────────
CONFIG_MAIN_STACK_SIZE=8192
CONFIG_SYSTEM_WORKQUEUE_STACK_SIZE=4096
CONFIG_HEAP_MEM_POOL_SIZE=65536

# ── Network buffers ──────────────────────────────────────────────────────────
CONFIG_NET_PKT_RX_COUNT=16
CONFIG_NET_PKT_TX_COUNT=16
CONFIG_NET_BUF_RX_COUNT=32
CONFIG_NET_BUF_TX_COUNT=32

# ── Entropy / random walk telemetry ─────────────────────────────────────────
CONFIG_ENTROPY_GENERATOR=y

# ── Settings (NVS) – used by provisioning module ─────────────────────────────
CONFIG_SETTINGS=y
CONFIG_SETTINGS_NVS=y
CONFIG_NVS=y
CONFIG_FLASH=y
CONFIG_FLASH_MAP=y
CONFIG_FLASH_PAGE_LAYOUT=y

CONFIG_DHL_EMPLOYEE_ID="courier-001"

CONFIG_DHL_MQTT_BROKER_HOSTNAME="127.0.0.1"
CONFIG_DHL_MQTT_BROKER_PORT=1883
```

## boards/esp32_devkitc_procpu.conf
```kconfig
# ── Wi-Fi (station + AP mode) ───────────────────────────────────────────────
CONFIG_WIFI=y
CONFIG_NET_L2_WIFI_MGMT=y

CONFIG_NET_DHCPV4=y
CONFIG_NET_DHCPV4_SERVER=y
CONFIG_NET_HOSTNAME="dhl-courier-esp32"
CONFIG_DHL_WIFI_SSID="Personal-193"
CONFIG_DHL_WIFI_PSK="tercerob141"

# ── Reboot support (used on provisioning reset) ───────────────────────────────
CONFIG_REBOOT=y
```

## boards/native_sim_native_64.conf
```kconfig
# ── native_sim networking: offloaded sockets (no TAP, no root required) ─────
# Uses the host's BSD socket stack directly so that 127.0.0.1 resolves to
# the host's loopback (e.g. the dhl_mosquitto Docker container).

# Enable the net drivers menuconfig (required parent for offloaded sockets).
CONFIG_NET_DRIVERS=y

# Enable offloaded sockets – delegates to the host kernel network stack.
CONFIG_NET_SOCKETS_OFFLOAD=y
CONFIG_NET_NATIVE_OFFLOADED_SOCKETS=y

# Connectivity simulation: bring the "interface" up automatically so the
# firmware doesn't wait for a real link event.
CONFIG_NET_NATIVE_OFFLOADED_SOCKETS_CONNECTIVITY_SIM=y
CONFIG_NET_NATIVE_OFFLOADED_SOCKETS_CONNECTIVITY_SIM_AUTO_CONNECT=y
```

## src/main.c
```c
#include <errno.h>
#include <stdbool.h>
#include <stdint.h>
#include <stdio.h>
#include <string.h>
#include <time.h>

#include <zephyr/kernel.h>
#include <zephyr/logging/log.h>
#include <zephyr/net/conn_mgr_monitor.h>
#include <zephyr/net/mqtt.h>
#include <zephyr/net/net_if.h>
#include <zephyr/net/net_mgmt.h>
#include <zephyr/net/sntp.h>
#include <zephyr/net/socket.h>
#include <zephyr/posix/poll.h>
#include <zephyr/settings/settings.h>
#include <zephyr/sys/reboot.h>

#if defined(CONFIG_WIFI)
#include <zephyr/net/wifi_mgmt.h>
#endif

#include "gps_telemetry.h"
#include "provisioning.h"
#include "route_manager.h"
#include "ui_bridge.h"

LOG_MODULE_REGISTER(dhl_courier, LOG_LEVEL_INF);

#define MQTT_BUFFER_SIZE 1024
#define MQTT_CONNECT_TIMEOUT_MS 5000
#define MQTT_POLL_SLICE_MS 1000
#define WIFI_CONNECT_RETRIES 3
#define WIFI_CONNECT_TIMEOUT_S 30
#define NET_L4_EVENT_MASK (NET_EVENT_L4_CONNECTED | NET_EVENT_L4_DISCONNECTED)

/* Topic prefix for route assignments from the backend */
#define ROUTE_TOPIC_PREFIX "routes/"
#define ALERTS_SOS_TOPIC_PREFIX "alerts/sos/"
#define DELIVERED_TOPIC_PREFIX "delivered/"
#define MQTT_TOPIC_SIZE 96
#define MQTT_PAYLOAD_SIZE 192
#define MQTT_TIMESTAMP_SIZE 32
#define MQTT_COORDINATE_SIZE 16
#define UI_SLEEP_SLICE_MS 100

/* Next MQTT message id for subscribe / QoS-1 ack (wraps at UINT16_MAX) */
static uint16_t next_msg_id = 1U;

static uint8_t rx_buffer[MQTT_BUFFER_SIZE];
static uint8_t tx_buffer[MQTT_BUFFER_SIZE];

static struct mqtt_client client_ctx;
static struct sockaddr_storage broker;
static struct pollfd mqtt_fds[1];
static struct net_mgmt_event_callback net_l4_cb;

#if defined(CONFIG_WIFI)
static struct net_mgmt_event_callback wifi_cb;
#endif

static int mqtt_nfds;
static bool mqtt_connected;
static bool network_ready;

/* Runtime provisioning config (loaded from NVS or set via captive portal) */
static struct prov_config g_prov;

K_SEM_DEFINE(network_ready_sem, 0, 1);

static void clear_fds(void)
{
    mqtt_nfds = 0;
    mqtt_fds[0].fd = -1;
    mqtt_fds[0].events = 0;
    mqtt_fds[0].revents = 0;
}

static void prepare_fds(struct mqtt_client* client)
{
    mqtt_fds[0].fd = client->transport.tcp.sock;
    mqtt_fds[0].events = POLLIN;
    mqtt_fds[0].revents = 0;
    mqtt_nfds = 1;
}

static int wait_on_socket(int timeout_ms)
{
    if (mqtt_nfds == 0)
    {
        return 0;
    }

    return poll(mqtt_fds, mqtt_nfds, timeout_ms);
}

static void format_coordinate(char* buf, size_t size, int32_t microdegrees)
{
    int64_t absolute_value = (microdegrees < 0) ? -(int64_t)microdegrees : (int64_t)microdegrees;
    int64_t integer_part = absolute_value / 1000000LL;
    int64_t fractional_part = absolute_value % 1000000LL;

    snprintf(buf, size, "%s%lld.%06lld", microdegrees < 0 ? "-" : "", (long long)integer_part,
             (long long)fractional_part);
}

static void refresh_ui_stop(void)
{
    int current_index = get_current_stop_index();
    int display_position = current_index >= 0 ? current_index + 1 : 0;

    ui_update_stop(get_current_stop(), display_position, get_stop_count());
}

static void ui_pump_sleep(int32_t duration_ms)
{
    while (duration_ms > 0)
    {
        int32_t slice_ms = duration_ms > UI_SLEEP_SLICE_MS ? UI_SLEEP_SLICE_MS : duration_ms;

        ui_process();
        k_msleep(slice_ms);
        duration_ms -= slice_ms;
    }
}

static int publish_json(struct mqtt_client* client, const char* topic, const char* payload)
{
    struct mqtt_publish_param param = {
        .message = {.topic = {.topic = {.utf8 = (const uint8_t*)topic, .size = strlen(topic)},
                              .qos = MQTT_QOS_0_AT_MOST_ONCE},
                    .payload = {.data = (uint8_t*)payload, .len = strlen(payload)}},
        .message_id = 0,
        .dup_flag = 0U,
        .retain_flag = 0U};

    return mqtt_publish(client, &param);
}

static int publish_employee_event(const char* topic_prefix, const char* payload)
{
    char topic[MQTT_TOPIC_SIZE];
    int rc;

    if (!mqtt_connected)
    {
        return -ENOTCONN;
    }

    rc = snprintf(topic, sizeof(topic), "%s%s", topic_prefix, g_prov.employee_id);
    if (rc < 0 || rc >= sizeof(topic))
    {
        return -EMSGSIZE;
    }

    return publish_json(&client_ctx, topic, payload);
}

static int build_iso8601_utc(char* buf, size_t size)
{
    time_t now = time(NULL);
    struct tm utc_now;

    if (now == (time_t)-1)
    {
        return -EINVAL;
    }

    if (gmtime_r(&now, &utc_now) == NULL)
    {
        return -EINVAL;
    }

    if (strftime(buf, size, "%Y-%m-%dT%H:%M:%SZ", &utc_now) == 0U)
    {
        return -EMSGSIZE;
    }

    return 0;
}

static void on_sos_pressed(void)
{
    int32_t lat_microdegrees;
    int32_t lng_microdegrees;
    char latitude[MQTT_COORDINATE_SIZE];
    char longitude[MQTT_COORDINATE_SIZE];
    char timestamp[MQTT_TIMESTAMP_SIZE];
    char payload[MQTT_PAYLOAD_SIZE];
    int rc;

    gps_telemetry_get_position(&lat_microdegrees, &lng_microdegrees);
    format_coordinate(latitude, sizeof(latitude), lat_microdegrees);
    format_coordinate(longitude, sizeof(longitude), lng_microdegrees);

    rc = build_iso8601_utc(timestamp, sizeof(timestamp));
    if (rc != 0)
    {
        LOG_WRN("Unable to build SOS timestamp (%d)", rc);
        return;
    }

    rc = snprintf(payload, sizeof(payload), "{\"time\":\"%s\",\"coordinates\":{\"lat\":%s,\"lon\":%s}}", timestamp,
                  latitude, longitude);
    if (rc < 0 || rc >= sizeof(payload))
    {
        LOG_WRN("SOS payload too large");
        return;
    }

    rc = publish_employee_event(ALERTS_SOS_TOPIC_PREFIX, payload);
    if (rc != 0)
    {
        LOG_WRN("Failed to publish SOS alert (%d)", rc);
        return;
    }

    LOG_INF("SOS alert published for %s", g_prov.employee_id);
}

static void on_delivered_pressed(void)
{
    const char* current_stop = get_current_stop();
    char payload[MQTT_PAYLOAD_SIZE];
    int rc;

    if (current_stop == NULL)
    {
        LOG_WRN("Delivered pressed without an active stop");
        return;
    }

    rc = snprintf(payload, sizeof(payload), "{\"stop\":\"%s\",\"status\":\"done\"}", current_stop);
    if (rc < 0 || rc >= sizeof(payload))
    {
        LOG_WRN("Delivered payload too large");
        return;
    }

    rc = publish_employee_event(DELIVERED_TOPIC_PREFIX, payload);
    if (rc != 0)
    {
        LOG_WRN("Failed to publish delivery confirmation (%d)", rc);
        return;
    }

    if (advance_stop() != 0)
    {
        LOG_WRN("Unable to advance route after delivery confirmation");
    }

    refresh_ui_stop();
    LOG_INF("Delivery confirmation published for \"%s\"", current_stop);
}

static int broker_init(struct sockaddr_storage* broker_addr)
{
    struct zsock_addrinfo hints = {0};
    struct zsock_addrinfo* result;
    char port[6];
    int rc;

    snprintf(port, sizeof(port), "%d", CONFIG_DHL_MQTT_BROKER_PORT);

    hints.ai_family = AF_INET;
    hints.ai_socktype = SOCK_STREAM;

    rc = zsock_getaddrinfo(CONFIG_DHL_MQTT_BROKER_HOSTNAME, port, &hints, &result);
    if (rc != 0)
    {
        LOG_ERR("Unable to resolve broker %s:%s (%s)", CONFIG_DHL_MQTT_BROKER_HOSTNAME, port, zsock_gai_strerror(rc));
        return -EHOSTUNREACH;
    }

    if (result->ai_addrlen > sizeof(*broker_addr))
    {
        zsock_freeaddrinfo(result);
        return -ENOMEM;
    }

    memset(broker_addr, 0, sizeof(*broker_addr));
    memcpy(broker_addr, result->ai_addr, result->ai_addrlen);
    zsock_freeaddrinfo(result);

    return 0;
}

static int subscribe_to_topics(struct mqtt_client* client)
{
    static char route_topic[sizeof(ROUTE_TOPIC_PREFIX) + sizeof(g_prov.employee_id)];

    snprintf(route_topic, sizeof(route_topic), "%s%s", ROUTE_TOPIC_PREFIX, g_prov.employee_id);

    struct mqtt_topic topics[] = {
        {
            .topic =
                {
                    .utf8 = (const uint8_t*)route_topic,
                    .size = strlen(route_topic),
                },
            .qos = MQTT_QOS_1_AT_LEAST_ONCE,
        },
    };

    struct mqtt_subscription_list sub_list = {
        .list = topics,
        .list_count = ARRAY_SIZE(topics),
        .message_id = next_msg_id++,
    };

    int rc = mqtt_subscribe(client, &sub_list);

    if (rc != 0)
    {
        LOG_ERR("mqtt_subscribe failed (%d)", rc);
    }
    else
    {
        LOG_INF("Subscribed to %s (msg_id %u)", route_topic, sub_list.message_id);
    }

    return rc;
}

static int handle_publish(struct mqtt_client* client, const struct mqtt_evt* evt)
{
    const struct mqtt_publish_param* pub = &evt->param.publish;
    const struct mqtt_topic* topic = &pub->message.topic;
    uint32_t payload_len = pub->message.payload.len;
    int rc;

    /* Read payload into a stack buffer (bounded by MQTT_BUFFER_SIZE) */
    uint8_t payload[MQTT_BUFFER_SIZE];
    size_t to_read = payload_len;

    if (to_read > sizeof(payload))
    {
        LOG_WRN("Publish payload too large (%u bytes), truncating", payload_len);
        to_read = sizeof(payload);
    }

    rc = mqtt_read_publish_payload(client, payload, to_read);
    if (rc < 0)
    {
        LOG_ERR("Failed to read MQTT payload (%d)", rc);
        return rc;
    }

    size_t received = (size_t)rc;

    /* Discard remaining bytes if payload was truncated */
    if (payload_len > to_read)
    {
        uint8_t discard;
        size_t remaining = payload_len - to_read;

        while (remaining > 0)
        {
            rc = mqtt_read_publish_payload(client, &discard, 1);
            if (rc <= 0)
            {
                break;
            }
            remaining--;
        }
    }

    /* ACK QoS 1 messages */
    if (topic->qos == MQTT_QOS_1_AT_LEAST_ONCE)
    {
        struct mqtt_puback_param ack = {
            .message_id = pub->message_id,
        };

        (void)mqtt_publish_qos1_ack(client, &ack);
    }

    /* Route topic? "routes/{employee_id}" */
    size_t prefix_len = strlen(ROUTE_TOPIC_PREFIX);

    if (topic->topic.size >= prefix_len && memcmp(topic->topic.utf8, ROUTE_TOPIC_PREFIX, prefix_len) == 0)
    {
        rc = route_manager_parse_json((const char*)payload, received);
        if (rc != 0)
        {
            LOG_WRN("Route JSON rejected (%d)", rc);
        }
        else
        {
            refresh_ui_stop();
        }
    }
    else
    {
        LOG_DBG("Unhandled topic: %.*s", (int)topic->topic.size, topic->topic.utf8);
    }

    return 0;
}

static void mqtt_evt_handler(struct mqtt_client* const client, const struct mqtt_evt* evt)
{
    switch (evt->type)
    {
    case MQTT_EVT_CONNACK:
        if (evt->result != 0)
        {
            LOG_ERR("MQTT connect failed (%d)", evt->result);
            break;
        }

        mqtt_connected = true;
        LOG_INF("MQTT connected to broker");

        /* Subscribe after every (re)connect so the broker
         * knows our topic interest even after a clean session. */
        subscribe_to_topics(client);
        break;

    case MQTT_EVT_SUBACK:
        LOG_INF("MQTT SUBACK received (msg_id %u)", evt->param.suback.message_id);
        break;

    case MQTT_EVT_PUBLISH:
        (void)handle_publish(client, evt);
        break;

    case MQTT_EVT_DISCONNECT:
        LOG_WRN("MQTT disconnected (%d)", evt->result);
        mqtt_connected = false;
        clear_fds();
        break;

    case MQTT_EVT_PINGRESP:
        LOG_DBG("MQTT PINGRESP received");
        break;

    default:
        LOG_DBG("Unhandled MQTT event type %d result %d", evt->type, evt->result);
        break;
    }
}

static int client_init(struct mqtt_client* client)
{
    int rc;

    rc = broker_init(&broker);
    if (rc != 0)
    {
        return rc;
    }

    mqtt_client_init(client);

    client->broker = &broker;
    client->evt_cb = mqtt_evt_handler;
    client->client_id.utf8 = (uint8_t*)CONFIG_DHL_MQTT_CLIENT_ID;
    client->client_id.size = strlen(CONFIG_DHL_MQTT_CLIENT_ID);
    client->password = NULL;
    client->user_name = NULL;
    client->protocol_version = MQTT_VERSION_3_1_1;
    client->rx_buf = rx_buffer;
    client->rx_buf_size = sizeof(rx_buffer);
    client->tx_buf = tx_buffer;
    client->tx_buf_size = sizeof(tx_buffer);
    client->transport.type = MQTT_TRANSPORT_NON_SECURE;
    client->keepalive = CONFIG_DHL_MQTT_KEEPALIVE;
    client->clean_session = 1U;

    return 0;
}

static int mqtt_connect_and_wait(struct mqtt_client* client)
{
    int64_t deadline = k_uptime_get() + MQTT_CONNECT_TIMEOUT_MS;
    int rc;

    mqtt_connected = false;
    clear_fds();

    rc = client_init(client);
    if (rc != 0)
    {
        return rc;
    }

    rc = mqtt_connect(client);
    if (rc != 0)
    {
        LOG_ERR("mqtt_connect failed (%d)", rc);
        return rc;
    }

    prepare_fds(client);

    while (!mqtt_connected && k_uptime_get() < deadline)
    {
        ui_process();

        rc = wait_on_socket(MQTT_POLL_SLICE_MS);
        if (rc < 0)
        {
            LOG_ERR("poll failed (%d)", errno);
            mqtt_abort(client);
            clear_fds();
            return -errno;
        }

        if (rc == 0)
        {
            continue;
        }

        rc = mqtt_input(client);
        if (rc != 0)
        {
            LOG_ERR("mqtt_input during connect failed (%d)", rc);
            mqtt_abort(client);
            clear_fds();
            return rc;
        }
    }

    if (!mqtt_connected)
    {
        LOG_ERR("Timed out waiting for MQTT CONNACK");
        mqtt_abort(client);
        clear_fds();
        return -ETIMEDOUT;
    }

    return 0;
}

static void sync_time_sntp(void)
{
    struct sntp_time sntp_ts;
    struct timespec ts;
    int rc;

    rc = sntp_simple("pool.ntp.org", 5000, &sntp_ts);
    if (rc != 0)
    {
        LOG_WRN("SNTP sync failed (%d) - timestamps may be inaccurate", rc);
        return;
    }

    ts.tv_sec = (time_t)sntp_ts.seconds;
    ts.tv_nsec = 0;

    if (clock_settime(CLOCK_REALTIME, &ts) != 0)
    {
        LOG_WRN("clock_settime failed");
        return;
    }

    LOG_INF("Time synced via SNTP");
}

static int mqtt_run(struct mqtt_client* client, const char* employee_id)
{
    int rc;
    int timeout_ms;

    while (mqtt_connected)
    {
        timeout_ms = mqtt_keepalive_time_left(client);
        if (timeout_ms < 0 || timeout_ms > MQTT_POLL_SLICE_MS)
        {
            timeout_ms = MQTT_POLL_SLICE_MS;
        }

        rc = wait_on_socket(timeout_ms);
        if (rc < 0)
        {
            LOG_ERR("poll failed (%d)", errno);
            return -errno;
        }

        if (rc > 0)
        {
            rc = mqtt_input(client);
            if (rc != 0)
            {
                LOG_ERR("mqtt_input failed (%d)", rc);
                return rc;
            }
        }

        rc = mqtt_live(client);
        if (rc != 0 && rc != -EAGAIN)
        {
            LOG_ERR("mqtt_live failed (%d)", rc);
            return rc;
        }

        if (rc == 0)
        {
            rc = mqtt_input(client);
            if (rc != 0)
            {
                LOG_ERR("mqtt_input after mqtt_live failed (%d)", rc);
                return rc;
            }
        }

        rc = gps_telemetry_publish(client, employee_id);
        if (rc != 0 && rc != -EAGAIN)
        {
            LOG_WRN("GPS telemetry publish failed (%d)", rc);
        }

        ui_process();
    }

    return 0;
}

static void net_l4_event_handler(struct net_mgmt_event_callback* cb, uint64_t mgmt_event, struct net_if* iface)
{
    ARG_UNUSED(cb);
    ARG_UNUSED(iface);

    switch (mgmt_event)
    {
    case NET_EVENT_L4_CONNECTED:
        network_ready = true;
        k_sem_give(&network_ready_sem);
        LOG_INF("Network connectivity up");
        break;

    case NET_EVENT_L4_DISCONNECTED:
        network_ready = false;
        LOG_WRN("Network connectivity down");
        break;

    default:
        break;
    }
}

#if defined(CONFIG_WIFI)
static K_SEM_DEFINE(wifi_assoc_sem, 0, 1);
static int wifi_assoc_result;

static void wifi_mgmt_event_handler(struct net_mgmt_event_callback* cb, uint64_t mgmt_event, struct net_if* iface)
{
    ARG_UNUSED(iface);

    if (mgmt_event == NET_EVENT_WIFI_CONNECT_RESULT)
    {
        const struct wifi_status* status = cb->info;

        wifi_assoc_result = status->status;
        if (status->status != 0)
        {
            LOG_ERR("Wi-Fi association failed (status %d)", status->status);
        }
        else
        {
            LOG_INF("Wi-Fi association completed");
        }
        k_sem_give(&wifi_assoc_sem);
    }
    else if (mgmt_event == NET_EVENT_WIFI_DISCONNECT_RESULT)
    {
        LOG_WRN("Wi-Fi disconnected");
    }
}

static int wifi_connect(const struct prov_config* prov)
{
    struct net_if* iface = net_if_get_default();
    struct wifi_connect_req_params params = {0};
    int rc;
    size_t ssid_len = strlen(prov->ssid);
    size_t psk_len = strlen(prov->psk);

    /* Security types to try in order — only what the ESP32 driver supports */
    static const enum wifi_security_type sec_types[] = {
        WIFI_SECURITY_TYPE_PSK,
        WIFI_SECURITY_TYPE_PSK_SHA256,
    };
    const int n_sec = psk_len > 0U ? 2 : 1;

    if (iface == NULL)
    {
        return -ENODEV;
    }

    if (ssid_len == 0U)
    {
        LOG_ERR("SSID is empty");
        return -EINVAL;
    }

    net_mgmt_init_event_callback(&wifi_cb, wifi_mgmt_event_handler,
                                 NET_EVENT_WIFI_CONNECT_RESULT | NET_EVENT_WIFI_DISCONNECT_RESULT);
    net_mgmt_add_event_callback(&wifi_cb);

    for (int s = 0; s < n_sec; s++)
    {
        params.ssid = (const uint8_t*)prov->ssid;
        params.ssid_length = (uint8_t)ssid_len;
        params.channel = WIFI_CHANNEL_ANY;
        params.band = WIFI_FREQ_BAND_UNKNOWN;
        params.mfp = WIFI_MFP_OPTIONAL;
        params.timeout = SYS_FOREVER_MS;

        if (psk_len > 0U)
        {
            params.psk = (const uint8_t*)prov->psk;
            params.psk_length = (uint8_t)psk_len;
            params.security = sec_types[s];
        }
        else
        {
            params.psk = NULL;
            params.psk_length = 0;
            params.security = WIFI_SECURITY_TYPE_NONE;
        }

        for (int attempt = 0; attempt < 2; attempt++)
        {
            /* Ensure driver is in a clean state before each attempt */
            net_mgmt(NET_REQUEST_WIFI_DISCONNECT, iface, NULL, 0);
            k_msleep(500);

            LOG_INF("Wi-Fi connect: SSID=\"%s\" sec=%d attempt %d/%d", prov->ssid, params.security, attempt + 1, 2);

            k_sem_reset(&wifi_assoc_sem);
            wifi_assoc_result = -1;

            rc = net_mgmt(NET_REQUEST_WIFI_CONNECT, iface, &params, sizeof(params));
            if (rc != 0)
            {
                LOG_WRN("Connect request rejected (%d)", rc);
                k_msleep(1000);
                continue;
            }

            rc = k_sem_take(&wifi_assoc_sem, K_SECONDS(WIFI_CONNECT_TIMEOUT_S));
            if (rc != 0)
            {
                LOG_WRN("Association timed out (sec=%d)", params.security);
                continue;
            }

            if (wifi_assoc_result == 0)
            {
                LOG_INF("Wi-Fi connected! (sec=%d)", params.security);
                return 0;
            }

            LOG_WRN("Association refused (status=%d, sec=%d)", wifi_assoc_result, params.security);
            k_msleep(1000);
        }
    }

    net_mgmt_del_event_callback(&wifi_cb);
    return -ECONNREFUSED;
}
#endif

static void wait_for_network(void)
{
    int64_t last_log_ms = 0;

    while (!network_ready)
    {
        ui_process();

        if (k_sem_take(&network_ready_sem, K_MSEC(UI_SLEEP_SLICE_MS)) == 0)
        {
            break;
        }

        if (k_uptime_get() - last_log_ms >= 1000)
        {
            LOG_INF("Waiting for network connectivity...");
            last_log_ms = k_uptime_get();
        }
    }
}

int main(void)
{
    struct net_if* iface;
    int rc;

    clear_fds();

    /* Initialise settings (NVS backend for provisioning) */
    rc = settings_subsys_init();
    if (rc != 0)
    {
        LOG_ERR("settings_subsys_init failed (%d)", rc);
        return rc;
    }

    settings_load();
    gps_telemetry_init();
    route_manager_init();
    rc = prov_load(&g_prov);
    if (rc != 0)
    {
        LOG_ERR("No provisioning available – set CONFIG_DHL_EMPLOYEE_ID and Wi-Fi creds when needed");
        ui_shutdown();
        return rc;
    }

    ui_init();
    ui_register_sos_callback(on_sos_pressed);
    ui_register_delivered_callback(on_delivered_pressed);
    refresh_ui_stop();

    iface = net_if_get_default();
    if (iface == NULL)
    {
        LOG_ERR("No network interface available");
        ui_shutdown();
        return -ENODEV;
    }

    net_mgmt_init_event_callback(&net_l4_cb, net_l4_event_handler, NET_L4_EVENT_MASK);
    net_mgmt_add_event_callback(&net_l4_cb);

#if defined(CONFIG_WIFI)
    /* ── Connect to the saved Wi-Fi network ───────────────────────────── */
    rc = wifi_connect(&g_prov);
    if (rc != 0)
    {
        LOG_ERR("Wi-Fi connect failed (%d) – erasing credentials and rebooting", rc);
        prov_erase();
        k_sleep(K_SECONDS(1));
        sys_reboot(SYS_REBOOT_COLD);
        return rc;
    }
#endif

#if defined(CONFIG_WIFI)
    conn_mgr_mon_resend_status();
    wait_for_network();
#else
    /* On native_sim the host network stack is always available;
     * there is no Wi-Fi association event to await. */
    network_ready = true;
#endif

    LOG_INF("Courier %s starting MQTT bootstrap", g_prov.employee_id);

    sync_time_sntp();

    while (1)
    {
        if (!network_ready)
        {
            wait_for_network();
        }

        rc = mqtt_connect_and_wait(&client_ctx);
        if (rc != 0)
        {
            LOG_WRN("MQTT connect attempt failed (%d), retrying in %d seconds", rc, CONFIG_DHL_MQTT_RECONNECT_DELAY);
            ui_pump_sleep(CONFIG_DHL_MQTT_RECONNECT_DELAY * MSEC_PER_SEC);
            continue;
        }

        gps_telemetry_start();
        rc = mqtt_run(&client_ctx, g_prov.employee_id);
        if (rc != 0)
        {
            LOG_WRN("MQTT loop ended with %d", rc);
        }

        gps_telemetry_stop();
        mqtt_disconnect(&client_ctx, NULL);
        mqtt_abort(&client_ctx);
        clear_fds();
        ui_pump_sleep(CONFIG_DHL_MQTT_RECONNECT_DELAY * MSEC_PER_SEC);
    }

    ui_shutdown();
    return 0;
}
```

## src/gps_telemetry.c
```c
#include <errno.h>
#include <stdbool.h>
#include <stdint.h>
#include <stdio.h>
#include <string.h>

#include <zephyr/kernel.h>
#include <zephyr/logging/log.h>
#include <zephyr/random/random.h>
#include <zephyr/sys/atomic.h>

#include "gps_telemetry.h"

LOG_MODULE_REGISTER(gps_telemetry, LOG_LEVEL_INF);

#define GPS_TOPIC_SIZE 64
#define GPS_COORD_SIZE 16
#define GPS_PAYLOAD_SIZE 128

static struct k_timer gps_timer;
static struct k_work gps_work;
static struct k_mutex gps_lock;
static atomic_t gps_pending;
static atomic_t gps_running;
static int32_t current_lat_microdegrees = GPS_BASE_LAT_MICRODEGREES;
static int32_t current_lng_microdegrees = GPS_BASE_LNG_MICRODEGREES;

static int32_t random_delta_microdegrees(void)
{
    uint32_t span = (GPS_RANDOM_STEP_MICRODEGREES * 2U) + 1U;

    return (int32_t)(sys_rand32_get() % span) - GPS_RANDOM_STEP_MICRODEGREES;
}

static void format_coordinate(char* buf, size_t size, int32_t microdegrees)
{
    int64_t absolute_value = (microdegrees < 0) ? -(int64_t)microdegrees : (int64_t)microdegrees;
    int64_t integer_part = absolute_value / 1000000LL;
    int64_t fractional_part = absolute_value % 1000000LL;

    snprintf(buf, size, "%s%lld.%06lld", microdegrees < 0 ? "-" : "", (long long)integer_part,
             (long long)fractional_part);
}

static void gps_work_handler(struct k_work* work)
{
    int32_t next_lat;
    int32_t next_lng;

    ARG_UNUSED(work);

    if (atomic_get(&gps_running) == 0)
    {
        return;
    }

    k_mutex_lock(&gps_lock, K_FOREVER);
    current_lat_microdegrees += random_delta_microdegrees();
    current_lng_microdegrees += random_delta_microdegrees();
    next_lat = current_lat_microdegrees;
    next_lng = current_lng_microdegrees;
    k_mutex_unlock(&gps_lock);

    atomic_set(&gps_pending, 1);
    LOG_DBG("GPS updated to %d,%d microdegrees", next_lat, next_lng);
}

static void gps_timer_handler(struct k_timer* timer)
{
    ARG_UNUSED(timer);

    if (atomic_get(&gps_running) != 0)
    {
        k_work_submit(&gps_work);
    }
}

void gps_telemetry_init(void)
{
    k_mutex_init(&gps_lock);
    k_work_init(&gps_work, gps_work_handler);
    k_timer_init(&gps_timer, gps_timer_handler, NULL);
    atomic_clear(&gps_pending);
    atomic_clear(&gps_running);
    current_lat_microdegrees = GPS_BASE_LAT_MICRODEGREES;
    current_lng_microdegrees = GPS_BASE_LNG_MICRODEGREES;
}

void gps_telemetry_start(void)
{
    atomic_clear(&gps_pending);
    atomic_set(&gps_running, 1);
    k_timer_start(&gps_timer, K_SECONDS(GPS_TELEMETRY_INTERVAL_SECONDS), K_SECONDS(GPS_TELEMETRY_INTERVAL_SECONDS));
}

void gps_telemetry_stop(void)
{
    atomic_clear(&gps_running);
    k_timer_stop(&gps_timer);
    atomic_clear(&gps_pending);
}

void gps_telemetry_get_position(int32_t* lat_microdegrees, int32_t* lng_microdegrees)
{
    k_mutex_lock(&gps_lock, K_FOREVER);

    if (lat_microdegrees != NULL)
    {
        *lat_microdegrees = current_lat_microdegrees;
    }

    if (lng_microdegrees != NULL)
    {
        *lng_microdegrees = current_lng_microdegrees;
    }

    k_mutex_unlock(&gps_lock);
}

int gps_telemetry_publish(struct mqtt_client* client, const char* employee_id)
{
    char topic[GPS_TOPIC_SIZE];
    char latitude[GPS_COORD_SIZE];
    char longitude[GPS_COORD_SIZE];
    char payload[GPS_PAYLOAD_SIZE];
    int32_t lat_snapshot;
    int32_t lng_snapshot;
    int rc;

    if (!atomic_cas(&gps_pending, 1, 0))
    {
        return -EAGAIN;
    }

    k_mutex_lock(&gps_lock, K_FOREVER);
    lat_snapshot = current_lat_microdegrees;
    lng_snapshot = current_lng_microdegrees;
    k_mutex_unlock(&gps_lock);

    format_coordinate(latitude, sizeof(latitude), lat_snapshot);
    format_coordinate(longitude, sizeof(longitude), lng_snapshot);

    rc = snprintf(topic, sizeof(topic), "tracking/%s", employee_id);
    if (rc < 0 || rc >= sizeof(topic))
    {
        return -EMSGSIZE;
    }

    rc = snprintf(payload, sizeof(payload), "{\"lat\":%s,\"lng\":%s}", latitude, longitude);
    if (rc < 0 || rc >= sizeof(payload))
    {
        return -EMSGSIZE;
    }

    struct mqtt_publish_param param = {
        .message = {.topic = {.topic = {.utf8 = (const uint8_t*)topic, .size = strlen(topic)},
                              .qos = MQTT_QOS_0_AT_MOST_ONCE},
                    .payload = {.data = (uint8_t*)payload, .len = strlen(payload)}},
        .message_id = 0,
        .dup_flag = 0U,
        .retain_flag = 0U};

    return mqtt_publish(client, &param);
}
```

## src/gps_telemetry.h
```c
#ifndef GPS_TELEMETRY_H_
#define GPS_TELEMETRY_H_

#include <stdint.h>

#include <zephyr/net/mqtt.h>

#define GPS_TELEMETRY_INTERVAL_SECONDS 5
#define GPS_BASE_LAT_MICRODEGREES (-31416600)
#define GPS_BASE_LNG_MICRODEGREES (-64183300)
#define GPS_RANDOM_STEP_MICRODEGREES 100

void gps_telemetry_init(void);
void gps_telemetry_start(void);
void gps_telemetry_stop(void);
void gps_telemetry_get_position(int32_t* lat_microdegrees, int32_t* lng_microdegrees);
int gps_telemetry_publish(struct mqtt_client* client, const char* employee_id);

#endif /* GPS_TELEMETRY_H_ */
```

## src/provisioning.c
```c
#include "provisioning.h"

#include <errno.h>
#include <string.h>

#include <zephyr/logging/log.h>
#include <zephyr/settings/settings.h>

LOG_MODULE_REGISTER(provisioning, LOG_LEVEL_INF);

#if defined(CONFIG_DHL_WIFI_SSID)
#define PROV_DEFAULT_SSID CONFIG_DHL_WIFI_SSID
#else
#define PROV_DEFAULT_SSID ""
#endif

#if defined(CONFIG_DHL_WIFI_PSK)
#define PROV_DEFAULT_PSK CONFIG_DHL_WIFI_PSK
#else
#define PROV_DEFAULT_PSK ""
#endif

#if defined(CONFIG_WIFI)
#define PROV_WIFI_REQUIRED 1
#else
#define PROV_WIFI_REQUIRED 0
#endif

/* ── NVS / settings keys ─────────────────────────────────────────────────── */
#define PROV_SETTINGS_ROOT "prov"
#define KEY_SSID PROV_SETTINGS_ROOT "/ssid"
#define KEY_PSK PROV_SETTINGS_ROOT "/psk"
#define KEY_EMPLOYEE_ID PROV_SETTINGS_ROOT "/eid"

/* ══════════════════════════════════════════════════════════════════════════
 * Settings handler – populated when settings_load() runs
 * ══════════════════════════════════════════════════════════════════════════ */

static struct prov_config g_flash_cfg;

static int prov_settings_set(const char* key, size_t len, settings_read_cb read_cb, void* cb_arg)
{
    if (strcmp(key, "ssid") == 0)
    {
        if (len > sizeof(g_flash_cfg.ssid) - 1)
        {
            len = sizeof(g_flash_cfg.ssid) - 1;
        }
        if (read_cb(cb_arg, g_flash_cfg.ssid, len) < 0)
        {
            return -EIO;
        }
        g_flash_cfg.ssid[len] = '\0';
    }
    else if (strcmp(key, "psk") == 0)
    {
        if (len > sizeof(g_flash_cfg.psk) - 1)
        {
            len = sizeof(g_flash_cfg.psk) - 1;
        }
        if (read_cb(cb_arg, g_flash_cfg.psk, len) < 0)
        {
            return -EIO;
        }
        g_flash_cfg.psk[len] = '\0';
    }
    else if (strcmp(key, "eid") == 0)
    {
        if (len > sizeof(g_flash_cfg.employee_id) - 1)
        {
            len = sizeof(g_flash_cfg.employee_id) - 1;
        }
        if (read_cb(cb_arg, g_flash_cfg.employee_id, len) < 0)
        {
            return -EIO;
        }
        g_flash_cfg.employee_id[len] = '\0';
    }
    return 0;
}

SETTINGS_STATIC_HANDLER_DEFINE(prov, PROV_SETTINGS_ROOT, NULL, prov_settings_set, NULL, NULL);

/* ══════════════════════════════════════════════════════════════════════════
 * NVS helpers (via Zephyr settings subsystem)
 * ══════════════════════════════════════════════════════════════════════════ */

int prov_load(struct prov_config* cfg)
{
    bool has_flash_employee_id = g_flash_cfg.employee_id[0] != '\0';
    bool has_flash_wifi = !PROV_WIFI_REQUIRED || g_flash_cfg.ssid[0] != '\0';

    /* g_flash_cfg was filled by the settings handler during settings_load() */
    if (has_flash_employee_id && has_flash_wifi)
    {
        *cfg = g_flash_cfg;
        LOG_INF("Loaded provisioning from NVS: ssid=%s eid=%s", cfg->ssid, cfg->employee_id);
        return 0;
    }

    memset(cfg, 0, sizeof(*cfg));

    /* Fall back to compile-time credentials if set */
    if (sizeof(PROV_DEFAULT_SSID) > 1 || sizeof(CONFIG_DHL_EMPLOYEE_ID) > 1)
    {
        strncpy(cfg->ssid, PROV_DEFAULT_SSID, sizeof(cfg->ssid) - 1);
        strncpy(cfg->psk, PROV_DEFAULT_PSK, sizeof(cfg->psk) - 1);
        strncpy(cfg->employee_id, CONFIG_DHL_EMPLOYEE_ID, sizeof(cfg->employee_id) - 1);
        cfg->ssid[sizeof(cfg->ssid) - 1] = '\0';
        cfg->psk[sizeof(cfg->psk) - 1] = '\0';
        cfg->employee_id[sizeof(cfg->employee_id) - 1] = '\0';

        if (cfg->employee_id[0] != '\0' && (!PROV_WIFI_REQUIRED || cfg->ssid[0] != '\0'))
        {
            LOG_INF("Using compile-time provisioning: ssid=%s eid=%s", cfg->ssid, cfg->employee_id);
            return 0;
        }
    }

    return -ENOENT;
}

int prov_save(const struct prov_config* cfg)
{
    int rc;

    rc = settings_save_one(KEY_SSID, cfg->ssid, strlen(cfg->ssid) + 1);
    if (rc)
    {
        return rc;
    }
    rc = settings_save_one(KEY_PSK, cfg->psk, strlen(cfg->psk) + 1);
    if (rc)
    {
        return rc;
    }
    rc = settings_save_one(KEY_EMPLOYEE_ID, cfg->employee_id, strlen(cfg->employee_id) + 1);
    if (rc)
    {
        return rc;
    }

    /* Also update in-memory cache */
    g_flash_cfg = *cfg;

    LOG_INF("Provisioning saved to flash");
    return 0;
}

void prov_erase(void)
{
    settings_delete(KEY_SSID);
    settings_delete(KEY_PSK);
    settings_delete(KEY_EMPLOYEE_ID);
    memset(&g_flash_cfg, 0, sizeof(g_flash_cfg));
    LOG_INF("Provisioning erased");
}
```

## src/provisioning.h
```c
#ifndef PROVISIONING_H
#define PROVISIONING_H

#include <stdbool.h>

#define PROV_SSID_MAX_LEN 33
#define PROV_PSK_MAX_LEN 65
#define PROV_USER_MAX_LEN 33

/**
 * @brief Credential set loaded from / saved to NVS flash.
 */
struct prov_config
{
    char ssid[PROV_SSID_MAX_LEN];
    char psk[PROV_PSK_MAX_LEN];
    char employee_id[PROV_USER_MAX_LEN];
};

/**
 * @brief Load provisioned credentials from NVS.
 *
 * @param cfg Output struct.
 * @return 0 if valid credentials were found, negative errno otherwise.
 */
int prov_load(struct prov_config* cfg);

/**
 * @brief Save credentials to NVS.
 *
 * @param cfg Credentials to persist.
 * @return 0 on success, negative errno otherwise.
 */
int prov_save(const struct prov_config* cfg);

/**
 * @brief Erase stored credentials (force re-provisioning on next boot).
 */
void prov_erase(void);

#endif /* PROVISIONING_H */
```

## src/route_manager.c
```c
#include <errno.h>
#include <string.h>

#include <cJSON.h>
#include <zephyr/kernel.h>
#include <zephyr/logging/log.h>

#include "route_manager.h"

LOG_MODULE_REGISTER(route_manager, LOG_LEVEL_INF);

static struct route_state state;
static K_MUTEX_DEFINE(route_lock);

void route_manager_init(void)
{
    k_mutex_lock(&route_lock, K_FOREVER);
    memset(&state, 0, sizeof(state));
    k_mutex_unlock(&route_lock);
}

void route_manager_update(const char* stops[], int count)
{
    k_mutex_lock(&route_lock, K_FOREVER);

    int space = CONFIG_DHL_ROUTE_MAX_STOPS - state.count;

    if (count > space)
    {
        LOG_WRN("Route append: %d stop(s) requested, only %d slot(s) free; clamping", count, space);
        count = space;
    }

    for (int i = 0; i < count; i++)
    {
        strncpy(state.stops[state.count + i], stops[i], CONFIG_DHL_ROUTE_STOP_NAME_MAX - 1);
        state.stops[state.count + i][CONFIG_DHL_ROUTE_STOP_NAME_MAX - 1] = '\0';
    }

    state.count += count;

    LOG_INF("Route append: +%d stop(s), total=%d, current=%d/%d", count, state.count, state.current_index + 1,
            state.count);

    k_mutex_unlock(&route_lock);
}

const char* get_current_stop(void)
{
    const char* name = NULL;

    k_mutex_lock(&route_lock, K_FOREVER);

    if (state.count > 0 && state.current_index < state.count)
    {
        name = state.stops[state.current_index];
    }

    k_mutex_unlock(&route_lock);
    return name;
}

int get_current_stop_index(void)
{
    int index = -1;

    k_mutex_lock(&route_lock, K_FOREVER);

    if (state.count > 0 && state.current_index < state.count)
    {
        index = state.current_index;
    }

    k_mutex_unlock(&route_lock);
    return index;
}

int get_stop_count(void)
{
    int count;

    k_mutex_lock(&route_lock, K_FOREVER);
    count = state.count;
    k_mutex_unlock(&route_lock);

    return count;
}

int advance_stop(void)
{
    int rc = -1;

    k_mutex_lock(&route_lock, K_FOREVER);

    if (state.count > 0 && state.current_index < state.count)
    {
        state.current_index++;

        if (state.current_index < state.count)
        {
            LOG_INF("Advanced to stop %d/%d: \"%s\"", state.current_index + 1, state.count,
                    state.stops[state.current_index]);
        }
        else
        {
            LOG_INF("Route completed after %d stop(s)", state.count);
        }

        rc = 0;
    }

    k_mutex_unlock(&route_lock);
    return rc;
}

void route_manager_clear(void)
{
    k_mutex_lock(&route_lock, K_FOREVER);
    memset(&state, 0, sizeof(state));
    LOG_INF("Route cleared");
    k_mutex_unlock(&route_lock);
}

int route_manager_parse_json(const char* json, size_t len)
{
    /*
     * cJSON_ParseWithLength requires a null-terminated string internally
     * but respects the length parameter to bound the parse.  We use it
     * instead of cJSON_Parse so we don't depend on the MQTT payload
     * being null-terminated.
     */
    cJSON* root = cJSON_ParseWithLength(json, len);

    if (root == NULL)
    {
        LOG_ERR("Route JSON parse failed");
        return -EINVAL;
    }

    if (!cJSON_IsArray(root))
    {
        LOG_ERR("Route JSON payload is not an array");
        cJSON_Delete(root);
        return -EINVAL;
    }

    int array_size = cJSON_GetArraySize(root);

    if (array_size == 0)
    {
        LOG_WRN("Received empty route array – clearing route");
        route_manager_clear();
        cJSON_Delete(root);
        return 0;
    }

    int count = array_size;

    if (count > CONFIG_DHL_ROUTE_MAX_STOPS)
    {
        LOG_WRN("Route has %d stops, clamping to %d", count, CONFIG_DHL_ROUTE_MAX_STOPS);
        count = CONFIG_DHL_ROUTE_MAX_STOPS;
    }

    /* Validate every element is a string before committing the update */
    const cJSON* elem;
    int idx = 0;

    cJSON_ArrayForEach(elem, root)
    {
        if (idx >= count)
        {
            break;
        }
        if (!cJSON_IsString(elem) || elem->valuestring == NULL)
        {
            LOG_ERR("Route element %d is not a string", idx);
            cJSON_Delete(root);
            return -EINVAL;
        }
        idx++;
    }

    /* Build a temporary pointer array for route_manager_update */
    const char* stops[CONFIG_DHL_ROUTE_MAX_STOPS];

    idx = 0;
    cJSON_ArrayForEach(elem, root)
    {
        if (idx >= count)
        {
            break;
        }
        stops[idx] = elem->valuestring;
        idx++;
    }

    route_manager_update(stops, count);
    cJSON_Delete(root);

    return 0;
}
```

## src/route_manager.h
```c
#ifndef ROUTE_MANAGER_H_
#define ROUTE_MANAGER_H_

#include <stddef.h>

#include <autoconf.h>

struct route_state
{
    char stops[CONFIG_DHL_ROUTE_MAX_STOPS][CONFIG_DHL_ROUTE_STOP_NAME_MAX];
    int count;
    int current_index;
};

/**
 * @brief Initialise the route manager (zeroes internal state).
 */
void route_manager_init(void);

/**
 * @brief Append stops to the current route.
 *
 * New stops are added after the last existing stop without resetting the
 * current position. To reset, publish an empty array ([]) which calls
 * route_manager_clear() internally.
 *
 * @param stops  Array of stop name pointers.
 * @param count  Number of stops to append (clamped to remaining free slots).
 */
void route_manager_update(const char* stops[], int count);

/**
 * @brief Get the name of the current stop.
 *
 * @return Pointer to the stop name, or NULL if the route is empty / exhausted.
 */
const char* get_current_stop(void);

/**
 * @brief Get the zero-based index of the current stop.
 *
 * @return Index of the active stop, or -1 if the route is empty/exhausted.
 */
int get_current_stop_index(void);

/**
 * @brief Return the total number of stops in the loaded route.
 */
int get_stop_count(void);

/**
 * @brief Advance to the next stop.
 *
 * @return 0 on success, -1 if the route is empty or already exhausted.
 */
int advance_stop(void);

/**
 * @brief Parse a JSON array of stop names and update the route.
 *
 * Expected format: ["Stop A", "Stop B", ...]
 * On parse failure the existing route is left untouched.
 *
 * @param json  Pointer to the JSON payload buffer.
 * @param len   Length of the JSON payload in bytes.
 * @return 0 on success, -EINVAL on malformed JSON or unexpected types.
 */
int route_manager_parse_json(const char* json, size_t len);

/**
 * @brief Clear the current route entirely.
 */
void route_manager_clear(void);

#endif /* ROUTE_MANAGER_H_ */
```
